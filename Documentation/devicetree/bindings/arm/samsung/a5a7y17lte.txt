## Documentation/devicetree/bindings/arm/samsung/a5a7y17lte.txt
```
Samsung Galaxy A5/A7 2017 board selection
=======================================

Board DT root property:

- samsung,board-id: one of "a5y17lte-eur", "a5y17lte-can",
  "a5y17lte-kor", "a7y17lte-eur" or "a7y17lte-kor".

This identifies the model and regional configuration independently of the
human-readable model name. Existing model_info-hw_rev and
model_info-hw_rev_end properties give the inclusive hardware revision range.
The region is not interchangeable with the hardware revision.

The shared bootstrap uses compatible "samsung,a5a7y17lte". Its original
/chosen/bootargs supplies androidboot.bootloader and androidboot.hw_rev.
A520F selects A5 EUR, A520W A5 CAN, A520K/L/S A5 KOR, A720F A7 EUR and
A720S A7 KOR. Unknown models and ambiguous revision matches are rejected.
Live demo unit descriptions are not part of the board catalogue.

CONFIG_EXYNOS7880_BOARD_DTBS embeds the existing regional DTBs and the
unmodified bootstrap in .dtb.init.rodata, using the standard kernel DTB
linker section. The catalogue is separate from the DTBH image and is
released with the kernel's init memory. It adds no new compiler or library
dependency. It is disabled in the regular device defconfigs.

The selected board tree is completed before early memory scanning. Firmware
changes are obtained by comparing the incoming bootstrap with its pristine
catalogue copy. Recognized changes to chosen, memory, reserved-memory, ECT,
serial-number and MAC properties are replayed onto the selected board tree.
The header reservation map and boot CPU ID are preserved as well.

DT structure checks use libfdt 1.7.2 with its upstream trailing-NOP fix.
Board selection additionally rejects duplicate paths and properties,
overlapping data blocks, overflowing reservations and excessive nesting.

This is deliberately not a general overlay mechanism. Unknown firmware
changes, changes to phandle declarations, incompatible boot-data layouts,
ambiguous identities and malformed trees are rejected. Board-specific
phandles remain those of the selected complete DT, rather than being merged
from a different model. The prepared DT occupies a permanent 512 KiB buffer:
flat-tree consumers can retain pointers after init memory has been freed.

This remains a staged implementation. It does not change DTBH packaging or
create a unified ROM product, and the bootstrap is not included in regular
per-device DTBH images. Before enabling it, check the final kernel size and
bootloader memory placement, and validate firmware changes and board
selection on physical A5 and A7 devices. Ordinary device trees continue to
use their existing hardware descriptions.
```

## Documentation/devicetree/bindings/net/wireless/qcom,cnss-sdio-legacy-bdf.txt
```
Optional legacy board-data selection for QCA9377 SDIO

The node with compatible = "qcom,cnss_sdio" may specify:

- qcom,legacy-bdf-max-hw-revision: maximum Samsung board_id that requires
  bdwlan30_OLD.bin and utfbd30_OLD.bin. A value of zero disables this choice.
  The value must fit in a signed 32-bit integer.

The board_id comes from Samsung's SEC_BSP support. If this property is
absent, the existing CONFIG_WLAN_QCA9377_DUAL_BDF threshold is retained.
With no Samsung board-id provider and a zero configured threshold, legacy
board-data selection remains disabled.

Galaxy A5 (2017) uses <3>; Galaxy A7 (2017) leaves the property absent and
uses the shared configuration's zero threshold.
```

## Documentation/devicetree/bindings/video/samsung,s6e3fa3-a5a7y17.txt
```
Samsung S6E3FA3 panels on Galaxy A5/A7 (2017)

The panel node referenced by the DSIM lcd_info phandle must identify its
command, dimming and mDNIe tables through compatible:

- "samsung,s6e3fa3-a5y17": Galaxy A5 (2017), AMS520MV
- "samsung,s6e3fa3-a7y17": Galaxy A7 (2017), AMS568MW

The shared driver selects the matching table set before probing the panel.
Existing timing, power and GPIO properties are unchanged.
```

## drivers/media/platform/exynos/fimc-is2-7880/vendor/Kconfig
```kconfig
menu "Vendor Feature Setting"
	depends on EXYNOS_FIMC_IS

choice
	prompt "Use vender features"
	depends on EXYNOS_FIMC_IS
	default FIMC_IS_7880_VENDOR_DEFAULT
	help
	  Use the vender specific features.

config FIMC_IS_7880_VENDOR_DEFAULT
        bool "Default"
config FIMC_IS_7880_VENDOR_MCD
        bool "MCD"
config FIMC_IS_7880_VENDOR_PSV
		bool "PSV"
endchoice

source "drivers/media/platform/exynos/fimc-is2-7880/vendor/psv/Kconfig"
source "drivers/media/platform/exynos/fimc-is2-7880/vendor/mcd/Kconfig"
endmenu
```

## drivers/media/platform/exynos/fimc-is2-7880/vendor/psv/Kconfig
```kconfig
config PSV_SFR_VERIFICATION
        bool "|-> Enable SFR verfication feature"
        depends on FIMC_IS_7880_VENDOR_PSV
        default n

config PSV_VECTOR_VERIFICATION
		bool "|-> Enable vector verfication feature"
		depends on FIMC_IS_7880_VENDOR_PSV
		default n

config PSV_ASB
		bool "|-> Enable ASB feature"
		depends on FIMC_IS_7880_VENDOR_PSV
		default n
```

## drivers/media/platform/exynos/fimc-is2/ischain/fimc-is-v5_10_0/Kconfig
```kconfig
config FIMC_IS_V5_10_0
	bool "Use fimc-is v5.10.0"
	depends on EXYNOS_FIMC_IS
	select EXYNOS_DEVICE_MIPI_CSIS_VER2 if SOC_EXYNOS7880
	select CSIS_V4_1 if SOC_EXYNOS7880
	select EXYNOS_FIMC_BNS if SOC_EXYNOS7880
	select FIMC_BNS_V4_10_0 if SOC_EXYNOS7880
	select CAMERA_CIS_SELECT if SOC_EXYNOS7880
	select CAMERA_ACT_SELECT if SOC_EXYNOS7880
	select CAMERA_FLASH_SELECT if SOC_EXYNOS7880
	select USE_DIRECT_IS_CONTROL if SOC_EXYNOS7880
	select CAMERA_MC_SCALER_VER2_USE if SOC_EXYNOS7880
	select MC_SCALER_V2_10 if SOC_EXYNOS7880
	select USE_HW_API_COMMON if SOC_EXYNOS7880
	default n
	help
	  fimc-is version 5.10.0
```

## fs/sdcardfs/Kconfig
```kconfig
#
# Android Sdcardfs configuation
#

source "fs/sdcardfs/$SDCARDFS_VERSION/Kconfig"
```
