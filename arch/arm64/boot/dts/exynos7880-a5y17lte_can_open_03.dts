/*
 * SAMSUNG Exynos7880 Universal board device tree source
 *
 * Copyright (c) 2015 Samsung Electronics Co., Ltd.
 *		http://www.samsung.com
 *
 * This program is free software; you can redistribute it and/or modify
 * it under the terms of the GNU General Public License version 2 as
 * published by the Free Software Foundation.
*/

#include "exynos7880-a5y17lte_eur_open_03.dts"

/ {
	model = "Samsung A5Y17 LTE CAN rev03 board based on Exynos 7880";
	compatible = "samsung, A5Y17 LTE CAN OPEN 03", "samsung,exynos7880";
};
